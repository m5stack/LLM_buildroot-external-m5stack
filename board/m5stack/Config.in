## board/m5stack/Config.in
```kconfig
config BR2_BOARD_M5STACK_NAME
	string "m5stack board name"
	default "AX630C_emmc_arm64_k419"
	help
	  AX630C_emmc_arm64_k419, AX650_emmc.


config BR2_M5STACK_BSP_SUPPORT_OPT
	string "opt.tar.gz url"
	default ""
	help
	  Support for the OPT files required by the system.

config BR2_M5STACK_BSP_SUPPORT_OPT_SHA256
	string "opt.tar.gz sha256"
	default ""
	help
	  Support for the OPT files sha256 required by the system.

config BR2_M5STACK_BSP_SUPPORT_SOC
	string "soc.tar.gz url"
	default ""
	help
	  Support for the SOC files required by the system.

config BR2_M5STACK_BSP_SUPPORT_SOC_SHA256
	string "soc.tar.gz sha256"
	default ""
	help
	  Support for the SOC files sha256 required by the system.

config BR2_M5STACK_BSP_SUPPORT_IMAGE_OVERLAY
	string "image_overlay.tar.gz url"
	default ""
	help
	  Boot firmware required by AXP.

config BR2_M5STACK_BSP_SUPPORT_IMAGE_OVERLAY_SHA256
	string "image_overlay.tar.gz sha256"
	default ""
	help
	  Boot firmware sha256 required by AXP.
```
